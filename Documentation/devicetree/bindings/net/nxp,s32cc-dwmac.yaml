## Documentation/devicetree/bindings/net/nxp,s32cc-dwmac.yaml
```yaml
# SPDX-License-Identifier: (GPL-2.0-only OR BSD-2-Clause)
# Copyright 2021-2022 NXP
%YAML 1.2
---
$id: "http://devicetree.org/schemas/net/nxp,s32cc-dwmac.yaml#"
$schema: "http://devicetree.org/meta-schemas/core.yaml#"

title: NXP S32CC DWMAC Ethernet controller

maintainers:
  - Jan Petrous <jan.petrous@nxp.com>
  - Chester Lin <clin@suse.com>

allOf:
  - $ref: "snps,dwmac.yaml#"

properties:
  compatible:
    enum:
      - nxp,s32cc-dwmac

  reg:
    items:
      - description: Main GMAC registers
      - description: S32 MAC control registers

  dma-coherent: true

  clocks:
    minItems: 5
    items:
      - description: Main GMAC clock
      - description: Peripheral registers clock
      - description: Transmit PCS clock
      - description: Transmit RGMII clock
      - description: Transmit RMII clock
      - description: Transmit MII clock
      - description: Receive PCS clock
      - description: Receive RGMII clock
      - description: Receive RMII clock
      - description: Receive MII clock
      - description:
          PTP reference clock. This clock is used for programming the
          Timestamp Addend Register. If not passed then the system
          clock will be used.

  clock-names:
    minItems: 5
    items:
      - const: stmmaceth
      - const: pclk
      - const: tx_pcs
      - const: tx_rgmii
      - const: tx_rmii
      - const: tx_mii
      - const: rx_pcs
      - const: rx_rgmii
      - const: rx_rmii
      - const: rx_mii
      - const: ptp_ref

  tx-fifo-depth:
    const: 20480

  rx-fifo-depth:
    const: 20480

required:
  - compatible
  - reg
  - tx-fifo-depth
  - rx-fifo-depth
  - clocks
  - clock-names

unevaluatedProperties: false

examples:
  - |
    #include <dt-bindings/interrupt-controller/arm-gic.h>
    #include <dt-bindings/interrupt-controller/irq.h>

    #define S32GEN1_SCMI_CLK_GMAC0_AXI
    #define S32GEN1_SCMI_CLK_GMAC0_TX_PCS
    #define S32GEN1_SCMI_CLK_GMAC0_TX_RGMII
    #define S32GEN1_SCMI_CLK_GMAC0_TX_RMII
    #define S32GEN1_SCMI_CLK_GMAC0_TX_MII
    #define S32GEN1_SCMI_CLK_GMAC0_RX_PCS
    #define S32GEN1_SCMI_CLK_GMAC0_RX_RGMII
    #define S32GEN1_SCMI_CLK_GMAC0_RX_RMII
    #define S32GEN1_SCMI_CLK_GMAC0_RX_MII
    #define S32GEN1_SCMI_CLK_GMAC0_TS

    soc {
      #address-cells = <1>;
      #size-cells = <1>;

      gmac0: ethernet@4033c000 {
        compatible = "nxp,s32cc-dwmac";
        reg = <0x4033c000 0x2000>, /* gmac IP */
              <0x4007C004 0x4>;    /* S32 CTRL_STS reg */
        interrupt-parent = <&gic>;
        interrupts = <GIC_SPI 57 IRQ_TYPE_LEVEL_HIGH>;
        interrupt-names = "macirq";
        phy-mode = "rgmii-id";
        tx-fifo-depth = <20480>;
        rx-fifo-depth = <20480>;
        dma-coherent;
        clocks = <&clks S32GEN1_SCMI_CLK_GMAC0_AXI>,
                 <&clks S32GEN1_SCMI_CLK_GMAC0_AXI>,
                 <&clks S32GEN1_SCMI_CLK_GMAC0_TX_PCS>,
                 <&clks S32GEN1_SCMI_CLK_GMAC0_TX_RGMII>,
                 <&clks S32GEN1_SCMI_CLK_GMAC0_TX_RMII>,
                 <&clks S32GEN1_SCMI_CLK_GMAC0_TX_MII>,
                 <&clks S32GEN1_SCMI_CLK_GMAC0_RX_PCS>,
                 <&clks S32GEN1_SCMI_CLK_GMAC0_RX_RGMII>,
                 <&clks S32GEN1_SCMI_CLK_GMAC0_RX_RMII>,
                 <&clks S32GEN1_SCMI_CLK_GMAC0_RX_MII>,
                 <&clks S32GEN1_SCMI_CLK_GMAC0_TS>;
        clock-names = "stmmaceth", "pclk",
                      "tx_pcs", "tx_rgmii", "tx_rmii", "tx_mii",
                      "rx_pcs", "rx_rgmii", "rx_rmii", "rx_mii",
                      "ptp_ref";

        gmac0_mdio: mdio {
          #address-cells = <1>;
          #size-cells = <0>;
          compatible = "snps,dwmac-mdio";

          ethernet-phy@4 {
            reg = <0x04>;
          };
        };
      };
    };
```

## Documentation/devicetree/bindings/pinctrl/nxp,s32cc-siul2-pinctrl.yaml
```yaml
# SPDX-License-Identifier: (GPL-2.0-only OR BSD-2-Clause)
# Copyright 2022 NXP
%YAML 1.2
---
$id: http://devicetree.org/schemas/pinctrl/nxp,s32cc-siul2-pinctrl.yaml#
$schema: http://devicetree.org/meta-schemas/core.yaml#

title: NXP S32 Common Chassis SIUL2 iomux controller

maintainers:
  - Ghennadi Procopciuc <Ghennadi.Procopciuc@nxp.com>
  - Chester Lin <clin@suse.com>

description: |
  Core driver for the pin controller found on S32 Common Chassis SoC.

properties:
  compatible:
    enum:
      - nxp,s32g2-siul2-pinctrl

  reg:
    description:
      A list of MSCR/IMCR register regions to be reserved.
      - MSCR (Multiplexed Signal Configuration Register)
        An MSCR register can configure the associated pin as either a GPIO pin
        or a function output pin depends on the selected signal source.
      - IMCR (Input Multiplexed Signal Configuration Register)
        An IMCR register can configure the associated pin as function input
        pin depends on the selected signal source.
    minItems: 5
    items:
      - description: MSCR registers group 0 managed by the SIUL2 controller 0
      - description: MSCR registers group 1 managed by the SIUL2 controller 1
      - description: MSCR registers group 2 managed by the SIUL2 controller 1
      - description: IMCR registers group 0 managed by the SIUL2 controller 0
      - description: IMCR registers group 1 managed by the SIUL2 controller 1
      - description: IMCR registers group 2 managed by the SIUL2 controller 1

required:
  - compatible
  - reg

patternProperties:
  '-pins$':
    type: object
    additionalProperties: false

    patternProperties:
      '-grp[0-9]$':
        type: object
        allOf:
          - $ref: pinmux-node.yaml#
          - $ref: pincfg-node.yaml#
        unevaluatedProperties: false
        description:
          Pinctrl node's client devices specify pin muxes using subnodes,
          which in turn use the standard properties.

additionalProperties: false

examples:
  - |

    /* Pins functions (SSS field) */
    #define FUNC0  0
    #define FUNC1  1
    #define FUNC2  2
    #define FUNC3  3
    #define FUNC4  4
    #define FUNC5  5
    #define FUNC6  6
    #define FUNC7  7

    #define S32CC_PINMUX(PIN, FUNC) (((PIN) << 4) | (FUNC))

    #define S32CC_SLEW_208MHZ  0
    #define S32CC_SLEW_166MHZ  4
    #define S32CC_SLEW_150MHZ  5
    #define S32CC_SLEW_133MHZ  6
    #define S32CC_SLEW_83MHZ   7

    pinctrl@4009c240 {
        compatible = "nxp,s32g2-siul2-pinctrl";

        /*
         * There are two SIUL2 controllers in S32G2:
         *
         *   siul2_0 @ 0x4009c000
         *   siul2_1 @ 0x44010000
         *
         * Every SIUL2 controller has multiple register types, and here
         * only MSCR and IMCR registers need to be revealed for kernel
         * to configure pinmux. Please note that some indexes are reserved,
         * such as MSCR102-MSCR111 in the following reg property.
         */

              /* MSCR0-MSCR101 registers on siul2_0 */
        reg = <0x4009c240 0x198>,
              /* MSCR112-MSCR122 registers on siul2_1 */
              <0x44010400 0x2c>,
              /* MSCR144-MSCR190 registers on siul2_1 */
              <0x44010480 0xbc>,
              /* IMCR0-IMCR83 registers on siul2_0 */
              <0x4009ca40 0x150>,
              /* IMCR119-IMCR397 registers on siul2_1 */
              <0x44010c1c 0x45c>,
              /* IMCR430-IMCR495 registers on siul2_1 */
              <0x440110f8 0x108>;

        llce-can0-pins {
            llce-can0-grp0 {
                pinmux = <S32CC_PINMUX(43, FUNC0)>;
                input-enable;
                slew-rate = <S32CC_SLEW_208MHZ>;
            };

            llce-can0-grp1 {
                pinmux = <S32CC_PINMUX(44, FUNC2)>;
                output-enable;
                slew-rate = <S32CC_SLEW_208MHZ>;
            };
        };
    };
...
```

## Documentation/devicetree/bindings/pinctrl/nxp,s32g2-siul2-pinctrl.yaml
```yaml
# SPDX-License-Identifier: GPL-2.0
# Copyright (c) 2021 NXP
%YAML 1.2
---
$id: http://devicetree.org/schemas/pinctrl/nxp,s32g2-siul2-pinctrl.yaml#
$schema: http://devicetree.org/meta-schemas/core.yaml#

title: NXP SIUL2 IOMUX Controllers.

maintainers:
  - Ghennadi Procopciuc <Ghennadi.Procopciuc@nxp.com>
  - Chester Lin <clin@suse.com>

description: |
  An IOMUX controller driver for S32G2. There are two SIUL2 on S32G2.

properties:
  compatible:
    enum:
      - nxp,s32g2-siul2-pinctrl0
      - nxp,s32g2-siul2-pinctrl1

# Client device subnode's properties
patternProperties:
  'grp$':
    type: object
    description:
      Pinctrl node's client devices use subnodes for desired pin configuration.
      Client device subnodes use below standard properties.

    properties:
      fsl,pins:
        description:
          each entry consists of 2 integers and represents the mux and config
          setting for one pin. Even though IMCR register should be used as input
          register, it can be set and addressed in the same way as MSCR, only
          instead of passing the IMCR index, IMCR_IDX + 512 is passed.

        $ref: /schemas/types.yaml#/definitions/uint32-matrix
        items:
          items:
            - description: |
                "pinmux-id" indicates the pinmux ID.
            - description: |
                "mux-value" indicates the config value to this pin.

    required:
      - fsl,pins

    additionalProperties: false

required:
  - compatible

allOf:
  - $ref: "pinctrl.yaml#"

additionalProperties: false

examples:
  - |
    #include <dt-bindings/clock/s32g2-clock.h>

    pinctrl0: pinctrl {
        compatible = "nxp,s32g2-siul2-pinctrl0";
        #pinctrl-cells = <2>;
        reg = <0x4009c240 0x198>,
              <0x4009ca40 0x150>;
               /* MSCR range */
        pins = <&pinctrl0 0 101>,
               /* IMCR range */
               <&pinctrl0 512 595>;

        pinctrl0_gmac0_rgmii_c: gmac0rgmiicgrp {
            fsl,pins = <
                S32G2_GMAC0_TXCLK_OUT PAD_CTL_ENET_CFG1
                S32G2_GMAC0_TXCLK_IN  PAD_CTL_SRC_SIG_SEL2
                S32G2_GMAC0_TXEN_OUT  PAD_CTL_ENET_CFG2
            >;
        };
    };

...
```
